## subsys/Kconfig
```kconfig
menu "Systems and OS Services in Aspeed Zephyr Project"

rsource "mctp/Kconfig"

endmenu
```

## west.yml
```yaml
# Copyright (c) 2022 ASPEED Technology Inc.
# SPDX-License-Identifier: MIT

manifest:
  self:
    path: aspeed-zephyr-project

  remotes:
    - name: github
      url-base: https://github.com/AspeedTech-BMC
    - name: zephyr
      url-base: https://github.com/zephyrproject-rtos

  projects:
    - name: zephyr
      remote: github
      revision: 0132a9442cf34ace7022f67a63dcff170e703ae3
      import:
        name-whitelist:
          - mcumgr
          - cmsis
          - mcuboot
          - mbedtls
    - name: cerberus
      remote: github
      revision: 14cc8ba99aea8db8928c810092da3ff28d45be1b
      path: middlewares/cerberus
    - name: mcuboot
      remote: github
      revision: 6103efe89a65860a12fe7918028d469b82699270
      path: bootloader/mcuboot
    - name: libmctp
      revision: b97860e78998551af99931ece149eeffc538bdb1
      path: modules/lib/libmctp
      remote: zephyr
```
