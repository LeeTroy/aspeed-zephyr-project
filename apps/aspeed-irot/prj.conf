## CMakeLists.txt
```
# SPDX-License-Identifier: Apache-2.0

cmake_minimum_required(VERSION 3.20.0)

find_package(Zephyr REQUIRED HINTS $ENV{ZEPHYR_BASE})
project(hello_world)

zephyr_link_libraries(mbedTLS)
zephyr_link_libraries(dmtf_libspdm)
zephyr_include_directories(mbedTLS)
zephyr_include_directories(.)
zephyr_include_directories(src/include)

target_sources(app PRIVATE src/main.c src/spdm_req.c)
```

## prj.conf
```kconfig
# nothing here

# LIBSPDM
CONFIG_DMTF_LIBSPDM=y

# MBEDTLS
CONFIG_MBEDTLS=y
CONFIG_MBEDTLS_BUILTIN=y
CONFIG_CUSTOM_MBEDTLS_CFG_FILE=y
CONFIG_MBEDTLS_CFG_FILE="mbedtls/libspdm_mbedtls_config.h"
#CONFIG_MBEDTLS_CIPHER_ALL_ENABLED=y
CONFIG_MBEDTLS_KEY_EXCHANGE_ALL_ENABLED=y
CONFIG_MBEDTLS_ECP_C=y
CONFIG_MBEDTLS_ECP_ALL_ENABLED=y
CONFIG_MBEDTLS_ZEROIZE_ALT=y
CONFIG_MBEDTLS_ECDH_C=y
CONFIG_MBEDTLS_ECDSA_C=y
CONFIG_MBEDTLS_ECP_DP_SECP256R1_ENABLED=y
CONFIG_MBEDTLS_ECP_DP_SECP384R1_ENABLED=y
CONFIG_MBEDTLS_ECJPAKE_C=y
#CONFIG_MBEDTLS_ECP_ALL_ENABLED=y
CONFIG_MBEDTLS_HASH_ALL_ENABLED=y

CONFIG_MCTP=y
CONFIG_MCTP_UART=y
```

## boards/ast2700_evb_ast2700_ssp.overlay
```dts
&dram_ro_region {
	reg = <0x0 DT_SIZE_M(2)>;
};
```

## src/spdm_req.c
```c
#include <zephyr/kernel.h>
#include <zephyr/logging/log.h>
#include <library/spdm_requester_lib.h>
#include <stdlib.h>

LOG_MODULE_REGISTER(spdm_req, LOG_LEVEL_DBG);

static void *spdm_req_ctx;


libspdm_return_t spdm_device_send_message(void *spdm_context,
		size_t message_size,
		const void *message,
		uint64_t timeout)
{
	LOG_DBG("Sending message of size %d", message_size);
	return LIBSPDM_STATUS_SUCCESS;
}

libspdm_return_t spdm_device_receive_message(void *spdm_context,
		size_t *message_size,
		void **message,
		uint64_t timeout)
{
	LOG_DBG("Receiving message");
	return LIBSPDM_STATUS_SUCCESS;
}

static int spdm_req_init(void)
{
	spdm_req_ctx = malloc(libspdm_get_context_size());
	if (spdm_req_ctx == NULL) {
		LOG_ERR("Failed to allocate SPDM requester context");
		return -ENOMEM;
	}

	libspdm_init_context(spdm_req_ctx);

	libspdm_register_device_io_func(spdm_req_ctx, spdm_device_send_message, spdm_device_receive_message);

	return 0;
}

SYS_INIT(spdm_req_init, APPLICATION, CONFIG_KERNEL_INIT_PRIORITY_DEFAULT);
```
